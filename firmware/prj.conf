## CMakeLists.txt
```
# Firmware for STM (Sampling MCU) for LLM project
# This is Zephyrs build system which contains the source files

cmake_minimum_required(VERSION 3.20.0)

find_package(Zephyr REQUIRED HINTS $ENV{ZEPHYR_BASE})
project(grader_fw)

target_sources(app PRIVATE

    src/main.c
    src/link.c
    src/cmd.c
    src/reply.c
    src/pins.c
    src/pins_table.c
    src/capture.c
    src/rig.c
)
```

## prj.conf
```kconfig
# Kconfig settings (turns off everything that would print to COM7, like the "Booting Zephyr", so only protocol replies are transmitted)
# print to it, no console, printk, no logging

CONFIG_CONSOLE=n
CONFIG_UART_CONSOLE=n
CONFIG_PRINTK=n
CONFIG_LOG=n
CONFIG_BOOT_BANNER=n

# Host link (interrupt driven UART)
CONFIG_SERIAL=y
CONFIG_UART_INTERRUPT_DRIVEN=y
CONFIG_STACK_SENTINEL=y

# man thread parses lines up to 1024 bytes on its stack
CONFIG_MAIN_STACK_SIZE=8192
```

## app.overlay
```dts
/*
 * Board-specific devicetree additions for the grader rig.
 *
 * grader,host-uart: the UART that talks to the PC. On the Nucleo-L476RG, USART2
 * (PA2/PA3) is wired to the ST-Link, which exposes it as a USB COM port.
 *
 * Todo later: measurement pins, timers, the student UART (USART1), DAC, ADC and I2C go
 * here too, matching config/pinmap.yaml in the host repo.
 */

/ {
    chosen {
        grader,host-uart = &usart2;
    };
};

&usart2 {
    current-speed = <115200>;
};

/*
 * TIM2 is the capture timer for FREQ (src/capture.c drives it directly with STM32 LL).
 * The board file gives TIM2 to a PWM output on PB10; turn that off so nothing else
 * claims the timer or its interrupt.
 */
&pwm2 {
    status = "disabled";
};
```

## src/main.c
```c
#include <zephyr/kernel.h>

#include "cmd.h"
#include "link.h"
#include "version.h"

// buffer for the request currently being handled
static struct line req;     // 1 KB: keep it off the stack

int main(void){

    // initialize the link (uart) and check for error
    if (link_init() != 0){

        // No host link, so there is nobody to report to (come back here)
        k_panic();
    }

    // startup message
    link_send_line("# grader-fw " FW_VERSION);

    // forever loop
    for (;;){
        
        // wait for the next complete request line (the thread sleeps here intil the UART interrupt queues a line)
        link_get_line(&req);

        // check to see if there if the data is fragmented
        if (req.too_long){
            link_send_line("ERR BADARG line longer than 1024 bytes");
            continue;
        }

        // parse and execute the request
        cmd_handle(req.text, link_send_line);
    }
    
    return 0;
}
```

## src/capture.c
```c
// Timer input capture with TIM2 (32-bit), set up with STM32 LL calls.
//
// One input pin feeds two capture channels:
//   CH1 = TI1, rising edges   (CCMR1 CC1S = direct)
//   CH2 = TI1, falling edges  (CCMR1 CC2S = indirect: IC2 is mapped on TI1)
// The timer free-runs at the full timer clock, so each edge's timestamp is latched by the
// hardware the moment it happens. The interrupt only reads the latched value, so interrupt
// latency does not change the measurement (it only limits how fast edges may come).
//
// TIM2 belongs to this file: app.overlay disables the board's default PWM on TIM2.

#include "capture.h"

#include <stdbool.h>
#include <zephyr/device.h>
#include <zephyr/devicetree.h>
#include <zephyr/drivers/clock_control.h>
#include <zephyr/drivers/clock_control/stm32_clock_control.h>
#include <zephyr/irq.h>
#include <zephyr/kernel.h>

#include <stm32_ll_bus.h>
#include <stm32_ll_gpio.h>
#include <stm32_ll_tim.h>

#define CAP_TIM_NODE DT_NODELABEL(timers2)
#define CAP_TIM      ((TIM_TypeDef *)DT_REG_ADDR(CAP_TIM_NODE))
#define CAP_IRQ      DT_IRQN(CAP_TIM_NODE)

// STM32 pins that can be routed to TIM2 channel 1 (STM32L476 datasheet, alternate functions).
// PA5 is also TIM2_CH1 but drives the Nucleo's green LED (LD2), so it is left out.
struct capture_input {
    char port;
    uint8_t pin;
    GPIO_TypeDef *gpio;
    uint32_t af;
};

static const struct capture_input inputs[] = {
    {'A', 0, GPIOA, LL_GPIO_AF_1},   // PA0  = TIM2_CH1 (Arduino header A0)
    {'A', 15, GPIOA, LL_GPIO_AF_1},  // PA15 = TIM2_CH1 (morpho header; free when using SWD)
};

static volatile struct capture_raw acc;  // filled by the interrupt during a window
static volatile bool rise_open;          // a rising edge was seen and its falling edge not yet
static uint32_t tim_clk_hz;
static bool initialized;

static void on_rise(uint32_t t){

    if (acc.rising == 0){
        acc.first_rise = t;
    }
    acc.last_rise = t;
    acc.rising++;
    rise_open = true;
}

static void on_fall(uint32_t t){

    acc.falling++;
    // only pulses whose rising edge was seen count towards the duty cycle
    // (the window may start in the middle of a high phase)
    if (rise_open){
        acc.high_ticks += (uint32_t)(t - acc.last_rise);   // unsigned subtraction handles wrap
        acc.high_count++;
        rise_open = false;
    }
}

static void cap_isr(const void *arg){

    ARG_UNUSED(arg);
    TIM_TypeDef *tim = CAP_TIM;
    uint32_t sr = tim->SR;
    bool rise = (sr & TIM_SR_CC1IF) != 0;
    bool fall = (sr & TIM_SR_CC2IF) != 0;

    // reading CCRx also clears its CCxIF flag
    uint32_t t_rise = rise ? tim->CCR1 : 0;
    uint32_t t_fall = fall ? tim->CCR2 : 0;

    // a capture arrived while the previous one was still unread: an edge was lost
    if (sr & (TIM_SR_CC1OF | TIM_SR_CC2OF)){
        acc.overruns++;
        tim->SR = ~(TIM_SR_CC1OF | TIM_SR_CC2OF);   // rc_w0: writing 0 clears, 1 leaves as is
    }

    // both edges pending (short pulse): handle them in the order they happened
    if (rise && fall && (int32_t)(t_fall - t_rise) < 0){
        on_fall(t_fall);
        on_rise(t_rise);
    }
    else {
        if (rise){
            on_rise(t_rise);
        }
        if (fall){
            on_fall(t_fall);
        }
    }
}

// turn on the TIM2 clock, read its rate and hook up its interrupt (once)
static int capture_init(void){

    static const struct stm32_pclken clocks[] = STM32_DT_CLOCKS(CAP_TIM_NODE);
    const struct device *clk = DEVICE_DT_GET(STM32_CLOCK_CONTROL_NODE);

    if (!device_is_ready(clk)){
        return CAPTURE_HW;
    }
    // clocks[0] = bus clock gate (APB1), clocks[1] = timer kernel clock (TIMPCLK1)
    if (clock_control_on(clk, (clock_control_subsys_t)&clocks[0]) != 0){
        return CAPTURE_HW;
    }
    if (clock_control_get_rate(clk, (clock_control_subsys_t)&clocks[1], &tim_clk_hz) != 0){
        return CAPTURE_HW;
    }

    IRQ_CONNECT(CAP_IRQ, DT_IRQ(CAP_TIM_NODE, priority), cap_isr, NULL, 0);
    irq_enable(CAP_IRQ);
    initialized = true;
    return CAPTURE_OK;
}

int capture_measure(char port, uint8_t pin, uint32_t window_ms, struct capture_raw *out){

    const struct capture_input *in = NULL;
    for (size_t i = 0; i < sizeof(inputs) / sizeof(inputs[0]); i++){
        if (inputs[i].port == port && inputs[i].pin == pin){
            in = &inputs[i];
        }
    }
    if (in == NULL){
        return CAPTURE_NO_TIMER;
    }
    if (!initialized){
        int rc = capture_init();
        if (rc != CAPTURE_OK){
            return rc;
        }
    }

    TIM_TypeDef *tim = CAP_TIM;
    uint32_t mask = 1u << in->pin;   // LL_GPIO_PIN_n == (1 << n)

    // fresh accumulators (the interrupt is off, so no race)
    acc = (struct capture_raw){0};
    rise_open = false;

    // route the pin to the timer: alternate function, with the internal pull-down.
    // When nothing drives the wire (the student's pin unconfigured, or the Nano booting or
    // in reset) a floating input picks up noise such as 60 Hz mains hum and turns it into
    // edges. The weak pull-down (~40 kOhm) holds it low, so an undriven pin reads as
    // no signal (frequency_hz=null). It does not load a real push-pull output.
    LL_AHB2_GRP1_EnableClock(LL_AHB2_GRP1_PERIPH_GPIOA);
    LL_GPIO_SetPinPull(in->gpio, mask, LL_GPIO_PULL_DOWN);
    if (in->pin < 8){
        LL_GPIO_SetAFPin_0_7(in->gpio, mask, in->af);
    }
    else {
        LL_GPIO_SetAFPin_8_15(in->gpio, mask, in->af);
    }
    LL_GPIO_SetPinMode(in->gpio, mask, LL_GPIO_MODE_ALTERNATE);

    // free-running 32-bit counter at the full timer clock (wraps after ~53 s at 80 MHz)
    LL_TIM_DisableCounter(tim);
    LL_TIM_SetCounterMode(tim, LL_TIM_COUNTERMODE_UP);
    LL_TIM_SetPrescaler(tim, 0);
    LL_TIM_SetAutoReload(tim, UINT32_MAX);
    LL_TIM_GenerateEvent_UPDATE(tim);   // load the prescaler now

    // CH1: rising edges of TI1. The filter ignores glitches shorter than 4 clocks (50 ns);
    // it sits on TI1, so it applies to both channels
    LL_TIM_IC_SetActiveInput(tim, LL_TIM_CHANNEL_CH1, LL_TIM_ACTIVEINPUT_DIRECTTI);
    LL_TIM_IC_SetPolarity(tim, LL_TIM_CHANNEL_CH1, LL_TIM_IC_POLARITY_RISING);
    LL_TIM_IC_SetPrescaler(tim, LL_TIM_CHANNEL_CH1, LL_TIM_ICPSC_DIV1);
    LL_TIM_IC_SetFilter(tim, LL_TIM_CHANNEL_CH1, LL_TIM_IC_FILTER_FDIV1_N4);

    // CH2: falling edges of the same input (TI1)
    LL_TIM_IC_SetActiveInput(tim, LL_TIM_CHANNEL_CH2, LL_TIM_ACTIVEINPUT_INDIRECTTI);
    LL_TIM_IC_SetPolarity(tim, LL_TIM_CHANNEL_CH2, LL_TIM_IC_POLARITY_FALLING);
    LL_TIM_IC_SetPrescaler(tim, LL_TIM_CHANNEL_CH2, LL_TIM_ICPSC_DIV1);

    tim->SR = 0;
    NVIC_ClearPendingIRQ(CAP_IRQ);
    LL_TIM_CC_EnableChannel(tim, LL_TIM_CHANNEL_CH1 | LL_TIM_CHANNEL_CH2);
    LL_TIM_EnableIT_CC1(tim);
    LL_TIM_EnableIT_CC2(tim);
    LL_TIM_EnableCounter(tim);

    // the hardware does the timing; this thread just sleeps through the window
    k_msleep((int32_t)window_ms);

    LL_TIM_DisableIT_CC1(tim);
    LL_TIM_DisableIT_CC2(tim);
    LL_TIM_DisableCounter(tim);
    LL_TIM_CC_DisableChannel(tim, LL_TIM_CHANNEL_CH1 | LL_TIM_CHANNEL_CH2);
    NVIC_ClearPendingIRQ(CAP_IRQ);

    unsigned int key = irq_lock();
    *out = acc;
    irq_unlock(key);
    out->clock_hz = tim_clk_hz;

    // release the pin: plain input again (the pull-down stays on, so the line stays quiet)
    LL_GPIO_SetPinMode(in->gpio, mask, LL_GPIO_MODE_INPUT);
    return CAPTURE_OK;
}
```

## src/capture.h
```c
// Timer input capture on one STM32 pin: counts edges and times them over a window.
// Plain C header (no Zephyr includes) so cmd.c can still be compiled and tested on a PC;
// the implementation in capture.c is Zephyr + STM32 LL code.
#ifndef GRADER_CAPTURE_H
#define GRADER_CAPTURE_H

#include <stdint.h>

// raw result of one capture window. Timestamps are timer ticks at clock_hz
struct capture_raw {
    uint32_t clock_hz;      // timer tick rate (80 MHz with the default clock tree)
    uint32_t rising;        // rising edges seen in the window
    uint32_t falling;       // falling edges seen in the window
    uint32_t first_rise;    // tick of the first rising edge
    uint32_t last_rise;     // tick of the last rising edge
    uint64_t high_ticks;    // summed high time of every pulse whose rising edge was seen
    uint32_t high_count;    // number of pulses summed in high_ticks
    uint32_t overruns;      // edges lost because they came faster than the interrupt read them
};

// capture_measure return codes
enum {
    CAPTURE_OK = 0,
    CAPTURE_NO_TIMER = -1,  // this STM32 pin can't be routed to the capture timer
    CAPTURE_HW = -2,        // timer clock could not be set up
};

// Capture both edges on STM32 pin P<port><pin> for window_ms and fill *out.
// Blocks the calling thread for the window; the edges are timed in hardware.
int capture_measure(char port, uint8_t pin, uint32_t window_ms, struct capture_raw *out);

#endif
```

## src/cmd.c
```c
#include "cmd.h"

#include <stdio.h>
#include <string.h>

#include "capture.h"
#include "pins.h"
#include "reply.h"
#include "rig.h"
#include "version.h"

// most tokens a request can have (including the verb)
#define MAX_ARGS 16

// Size of the buffer for formatted error messages (reply_err adds "ERR <CODE> ")
#define REPLY_MAX 128

// struct for the args ()
struct args {
    int argc;               // number of tokens. including the verb
    char* argv[MAX_ARGS];   // pointer to the start of each token
};

// function to send its one reply through
typedef void (*handler_fn)(const struct args *a, reply_fn reply);

// One row of the command table: which verb, how many arguments it accepts, and which function handles it.
struct command {
    const char* verb;       // verb: PING, FREQ, etc.
    int min_args;           // fewest args after the vern
    int max_args;           // most args after the verb
    handler_fn handler;     // function called when the verb matches and the count is OK
};  


// ---------------------- handlers -----------------------------

// liveness and version check (host sends it on connect and after a T.O. to make sure the board is answering)
// also reports the pin-map hash so the host can check the firmware was built from the same config/pinmap.yaml
static void cmd_ping(const struct args *a, reply_fn reply){
    
    struct reply_buf r;
    (void) a;

    reply_begin(&r);
    reply_str(&r, "fw", (const uint8_t *)FW_VERSION, strlen(FW_VERSION));
    reply_str(&r, "protocol", (const uint8_t *)PROTOCOL_VERSION, strlen(PROTOCOL_VERSION));
    reply_str(&r, "pinmap", (const uint8_t *)pins_map_hash, strlen(pins_map_hash));
    reply_send(&r, reply);
}

// parse a plain decimal number (no sign, spaces or other characters); false if invalid or > max
static bool parse_u32(const char* s, uint32_t max, uint32_t* out){

    uint64_t v = 0;
    if (*s == '\0'){
        return false;
    }
    for (; *s != '\0'; s++){
        if (*s < '0' || *s > '9'){
            return false;
        }
        v = v * 10 + (uint64_t)(*s - '0');
        if (v > max){
            return false;
        }
    }
    *out = (uint32_t)v;
    return true;
}

// (num + den/2) / den: integer division rounded to nearest
static uint64_t div_round(uint64_t num, uint64_t den){
    return (num + den / 2) / den;
}

// FREQ <pin> <window_ms>: frequency and duty cycle of the signal on <pin> over the window
//   frequency_hz = (rising edges - 1) / (time from first to last rising edge)
//   duty_pct     = average high time / average period
//   edge_count   = rising edges in the window
// Fewer than 2 rising edges is a valid "no signal" result: frequency and duty are null.
static void cmd_freq(const struct args *a, reply_fn reply){

    char msg[REPLY_MAX];
    const char* name = a->argv[1];
    const struct pin_def* p = pins_find(name);
    uint32_t window_ms;
    struct capture_raw raw;
    struct reply_buf r;

    if (p == NULL){
        snprintf(msg, sizeof(msg), "pin %.16s is not in the pin map", name);
        reply_err(reply, "BADPIN", msg);
        return;
    }
    if (!pins_can_capture(p)){
        snprintf(msg, sizeof(msg), "pin %.16s has no timer_capture capability", name);
        reply_err(reply, "BADPIN", msg);
        return;
    }
    if (!pins_wired(p)){
        snprintf(msg, sizeof(msg), "pin %.16s is not wired (TBD in the pin map)", name);
        reply_err(reply, "BADPIN", msg);
        return;
    }
    if (!parse_u32(a->argv[2], 10000, &window_ms) || window_ms < 1){
        reply_err(reply, "BADARG", "window_ms must be 1-10000");
        return;
    }

    int rc = capture_measure(p->port, p->pin, window_ms, &raw);
    if (rc == CAPTURE_NO_TIMER){
        snprintf(msg, sizeof(msg), "no capture timer on P%c%u (pin %.16s)", p->port, (unsigned)p->pin, name);
        reply_err(reply, "BADPIN", msg);
        return;
    }
    if (rc != CAPTURE_OK){
        reply_err(reply, "INTERNAL", "capture timer setup failed");
        return;
    }
    // missed edges would make every number wrong: that's a rig fault, not a student fault
    if (raw.overruns != 0){
        reply_err(reply, "INTERNAL", "capture overrun: signal too fast to time every edge");
        return;
    }

    reply_begin(&r);
    uint32_t span = raw.last_rise - raw.first_rise;   // ticks, wrap-safe
    if (raw.rising >= 2 && span != 0){
        uint64_t periods = raw.rising - 1;

        // Hz with 3 decimals: clock * periods / span, times 1000
        uint64_t freq_mhz = div_round((uint64_t)raw.clock_hz * 1000u * periods, span);
        reply_fixed(&r, "frequency_hz", (int64_t)freq_mhz, 3);

        if (raw.high_count != 0){
            // average high time and period in ticks x1000, then % with 2 decimals
            uint64_t high_x1000 = div_round(raw.high_ticks * 1000u, raw.high_count);
            uint64_t period_x1000 = div_round((uint64_t)span * 1000u, periods);
            uint64_t duty_x100 = div_round(high_x1000 * 10000u, period_x1000);
            reply_fixed(&r, "duty_pct", (int64_t)duty_x100, 2);
        }
        else {
            reply_null(&r, "duty_pct");
        }
    }
    else {
        reply_null(&r, "frequency_hz");
        reply_null(&r, "duty_pct");
    }
    reply_int(&r, "edge_count", raw.rising);
    reply_send(&r, reply);
}

// WAIT <ms>: board-side delay, so all timing in a plan stays on the board (0-60000 ms).
// Replies OK once the time has passed.
static void cmd_wait(const struct args *a, reply_fn reply){

    uint32_t ms;
    struct reply_buf r;

    if (!parse_u32(a->argv[1], 60000, &ms)){
        reply_err(reply, "BADARG", "ms must be 0-60000");
        return;
    }
    rig_sleep_ms(ms);

    reply_begin(&r);
    reply_send(&r, reply);
}

// RESET: one pulse on the student board's RST line (the pin-map row with the reset
// capability). Replies OK once the line is released; the plan's WAIT gives the board time
// to boot. Later this also frees ARM slots.
static void cmd_reset(const struct args *a, reply_fn reply){

    char msg[REPLY_MAX];
    struct reply_buf r;
    const struct pin_def* p = pins_reset_line();
    (void) a;

    if (p == NULL){
        reply_err(reply, "BADPIN", "no reset line in the pin map");
        return;
    }
    if (!pins_wired(p)){
        snprintf(msg, sizeof(msg), "reset line %.16s is not wired (TBD in the pin map)", p->name);
        reply_err(reply, "BADPIN", msg);
        return;
    }
    if (rig_reset_pulse(p->port, p->pin) != 0){
        snprintf(msg, sizeof(msg), "could not drive reset line P%c%u", p->port, (unsigned)p->pin);
        reply_err(reply, "INTERNAL", msg);
        return;
    }

    reply_begin(&r);
    reply_send(&r, reply);
}

// Command Table
// Need to add drive, ... here as they are implemented
static const struct command commands[] = {
    {"PING", 0, 0, cmd_ping},
    {"FREQ", 2, 2, cmd_freq},
    {"WAIT", 1, 1, cmd_wait},
    {"RESET", 0, 0, cmd_reset},
};


// ------------------------------ dispatch -----------------------------------

// split on single or repeated spaces, returns -1 if there are too many tokens
static int split(char* line, struct args* a){

    // set the tokens to zero and iterate through the line
    a->argc = 0;
    for (char *p = line; *p != '\0';){
        
        // keep iterating until p is not a space anymore
        while (*p == ' '){
            *p++ = '\0';
        }

        // reached the end of the line, get out of loop
        if (*p == '\0'){
            break;
        }

        // p is at the start of a new token, but argv is already full
        if (a->argc == MAX_ARGS){
            return -1;
        }

        // record where this token starts and count it
        a->argv[a->argc++] = p;
        
        // move p past the token to the next space or the end of the line
        while (*p != '\0' && *p != ' '){
            p++;
        }
    }
    return 0;
}

// Handle one request line: split it find the verb in the commands, check number of args, and call the handler
void cmd_handle(char* line, reply_fn reply){

    // buffer for building the message and the split request (a)
    char msg[REPLY_MAX];
    struct args a;

    // checking the line
    if(split(line, &a) < 0){
        reply_err(reply, "BADCMD", "too many arguments");
        return;
    }

    // check to see if there are blank lines or a line of only spaces
    if (a.argc == 0){
        reply_err(reply, "BADCMD", "empty request");
        return;
    }

    // parsing through the available commands (only have PING right now)
    for (size_t i = 0; i < sizeof(commands) / sizeof(commands[0]); i++){

        // the current command that is being processed
        const struct command *c = &commands[i];

        // comapres the strings to see if the verb and arg match
        if (strcmp(a.argv[0], c->verb) != 0){
            continue;
        }

        // number of args, not counting the verb itself
        int n = a.argc - 1;

        // wrong arg count: reply with what was expected
        if (n < c->min_args || n > c->max_args){
            if (c->min_args == c->max_args){
                snprintf(msg, sizeof(msg), "%s takes %d arguments, got %d", c->verb, c->min_args, n);
            }
            else {
                snprintf(msg, sizeof(msg), "%s takes %d-%d arguments, got %d", c->verb, c->min_args, c->max_args, n);
            }
            reply_err(reply, "BADCMD", msg);
            return;
        }

        // verb and arg count are valid: handler checks the arg
        c->handler(&a, reply);
        return;
    }

    // No row matches.
    snprintf(msg, sizeof(msg), "unknown verb %.32s", a.argv[0]);
    reply_err(reply, "BADCMD", msg);
}
```

## src/cmd.h
```c
#ifndef GRADER_CMD_H
#define GRADER_CMD_H

#include <stddef.h>

// called with each reply line (no terminator)
typedef void (*reply_fn)(const char* line);

// Handles one request line from the host and send exactly one reply through 'reply'
void cmd_handle(char* line, reply_fn reply);

#endif
```

## src/link.c
```c
// This is the functionality for the UART layer
// The receive interrupt builds up a line one byte at a time. 
// When it sees \n it drops a trailing \r and pushes the finished line onto a message queue for the main thread
// Sending writes out one line and adds \name

#include "link.h"

#include <string.h>
#include <zephyr/device.h>
#include <zephyr/drivers/uart.h>
#include <zephyr/kernel.h>

// getting the UART (uart2) device
#define HOST_UART_NODE DT_CHOSEN(grader_host_uart)
static const struct device* const uart = DEVICE_DT_GET(HOST_UART_NODE);

// a queue for the data to be passed over the wire (one may be in transmission so need to store the ones that are ready)
K_MSGQ_DEFINE(line_q, sizeof(struct line), 4, 4);

// for constructing the message
static struct line rx;
static size_t rx_len;

// function for putting the line on the queue if we are unable to send at this moment
static void finish_line(void){

    // check the carraige return
    if (!rx.too_long && rx_len > 0 && rx.text[rx_len - 1] == '\r'){
        rx_len--;
    }

    // add null terminating char
    rx.text[rx_len] = '\0';

    // put on the wait queue
    (void) k_msgq_put(&line_q, &rx, K_NO_WAIT);

    // reset the variables
    rx_len = 0;
    rx.too_long = false;
}

// Todo: Need to come up with comments for this function and the lines in it 
static void uart_isr(const struct device* dev, void* user_data){

    // byte to store the data into from the fifo
    uint8_t c;

    // to silence the unused parameter warning - no data coming in yet
    ARG_UNUSED(user_data);

    // if the dev doesn't need to be updated or is not ready, return
    if(!uart_irq_update(dev) || !uart_irq_rx_ready(dev)){
        return;
    }

    // while there is still data in the fifo () -> telling the driver which UART to read from
    while(uart_fifo_read(dev, &c, 1) == 1){
        
        // if the char from the fifo is the new line character, call the finish line function so we can send it out
        if (c == '\n'){
            finish_line();
        }
        // protocol lines are printable ASCII: drop anything else (e.g. the 0x00 the ST-Link's
        // UART emits when the PC opens the COM port, which would otherwise end the C string
        // early and turn the first request into an "empty request")
        else if (c != '\r' && (c < 0x20 || c > 0x7E)){
            continue;
        }
        // if the received length is less than the max sending length, add the char from the fifo to the struct
        else if (rx_len < PROTO_LINE_MAX){
            rx.text[rx_len++] = (char) c;
        }
        else {
            rx.too_long = true;
        }
    }
}

// function for initializing uart (the link)
int link_init(void){
    
    // local variable declarations (junk is for useless data and ret is for checking the return type of the callback isr function)
    uint8_t junk;
    int ret;

    // if there is a tranmsission still active
    if (!device_is_ready(uart)){
        return -ENODEV;
    }

    // Drop anything that arrived before we were ready
    while (uart_poll_in(uart, &junk) == 0){}

    // the uart link is ready now, call the isr callback function and check the return type
    ret = uart_irq_callback_user_data_set(uart, uart_isr, NULL);
    if (ret < 0){
        return ret;
    }
    
    // enable rx interrupts
    uart_irq_rx_enable(uart);
    return 0;
}


void link_get_line(struct line *out){
    
    // k_msgq_get takes the oldest message out of line_q and copies it into the *out variable
    // K_FOREVER means: if the queue is empty, put this thread to sleep until something arrives
    (void) k_msgq_get(&line_q, out, K_FOREVER);
}


void link_send_line(const char* text){

    // iterate one char at a time until the null terminator and then append the \n
    for (const char* p = text; *p != '\0'; p++){
        // busy waits the USART data register (blocking)
        uart_poll_out(uart, (unsigned char)*p);
    }
    uart_poll_out(uart, '\n');
}
```

## src/link.h
```c
// header for the UART layer (named link.h)
#ifndef GRADER_LINK_H
#define GRADER_LINK_H

// included header files
#include <stdbool.h>
#include <stddef.h>

// max length of a transmission over UART (from docs/protocol.md - excluding the null terminator)
#define PROTO_LINE_MAX 1024

// info for transmitting data
struct line {
    char text[PROTO_LINE_MAX + 1];    // added one for the null terminator
    bool too_long;  // boolean to see if the line length was longer than LINE_MAX because the text is cutoff in this case
};


// Sets up the host UART and its receive interrupt - returns 0 if successfull and negative errno if failed
int link_init(void);

// function that blocks until the next complete line from the host arrives
void link_get_line(struct line *out);

// functions that sends one line to the host (\n is appended)
void link_send_line(const char *text);

#endif
```

## src/pins.c
```c
// Zephyr side of the pin table: port letter -> GPIO device.
// The plain-C lookups (pins_find, pins_wired, ...) are in pins_table.c.

#include "pins.h"

#include <zephyr/device.h>
#include <zephyr/devicetree.h>

// one case per GPIO port the L476RG (LQFP64) has, only if it is enabled in the devicetree
const struct device* pins_port_device(char port){

    switch (port){
#if DT_NODE_HAS_STATUS(DT_NODELABEL(gpioa), okay)
        case 'A': return DEVICE_DT_GET(DT_NODELABEL(gpioa));
#endif
#if DT_NODE_HAS_STATUS(DT_NODELABEL(gpiob), okay)
        case 'B': return DEVICE_DT_GET(DT_NODELABEL(gpiob));
#endif
#if DT_NODE_HAS_STATUS(DT_NODELABEL(gpioc), okay)
        case 'C': return DEVICE_DT_GET(DT_NODELABEL(gpioc));
#endif
#if DT_NODE_HAS_STATUS(DT_NODELABEL(gpiod), okay)
        case 'D': return DEVICE_DT_GET(DT_NODELABEL(gpiod));
#endif
#if DT_NODE_HAS_STATUS(DT_NODELABEL(gpioh), okay)
        case 'H': return DEVICE_DT_GET(DT_NODELABEL(gpioh));
#endif
        default:
            return NULL;
    }
}
```

## src/pins.h
```c
// pin table lookups: student-board pin names (from the plan) -> STM32 port and pin
// The table itself is generated from config/pinmap.yaml into pins_gen.h
#ifndef GRADER_PINS_H
#define GRADER_PINS_H

#include <stdbool.h>
#include <stdint.h>

// one row of the generated pin table
struct pin_def {
    const char* name;   // student-board name, e.g. "D5"
    char port;          // STM32 port letter 'A', 'B', ... or 0 if not wired (TBD in the pin map)
    uint8_t pin;        // pin number within the port (0-15)
    uint32_t caps;      // CAP_* bits from pins_gen.h
};

// declared here so this header stays free of Zephyr includes
struct device;

// pin-map hash compiled into this firmware (PINMAP_HASH from pins_gen.h), reported by PING
extern const char pins_map_hash[];

// returns the table row for a student-board pin name, or NULL if the name is unknown
const struct pin_def* pins_find(const char* name);

// true if the pin is wired to a real STM32 pin
bool pins_wired(const struct pin_def* p);

// true if the pin map gives the pin the timer_capture capability
bool pins_can_capture(const struct pin_def* p);

// returns the row with the reset capability (the line to the student board's RST pin),
// or NULL if the pin map has none
const struct pin_def* pins_reset_line(void);

// returns the Zephyr GPIO device for a port letter, or NULL if the port doesn't exist or isn't enabled
const struct device* pins_port_device(char port);

#endif
```

## src/pins_gen.h
```c
/*
 * GENERATED FILE - DO NOT EDIT.
 * Source: config/pinmap.yaml
 * Regenerate: python scripts/gen_pins_h.py   (check: --check)
 */
#ifndef GRADER_PINS_GEN_H
#define GRADER_PINS_GEN_H

#include "pins.h"

/* First 8 hex chars of SHA-256 of the canonical pin map (host: pinmap_hash). */
#define PINMAP_HASH "6e27016f"

#define CAP_GPIO          (1u << 0)
#define CAP_DRIVE         (1u << 1)
#define CAP_TIMER_CAPTURE (1u << 2)
#define CAP_UART_RX       (1u << 3)
#define CAP_UART_TX       (1u << 4)
#define CAP_ANALOG_IN     (1u << 5)
#define CAP_DAC           (1u << 6)
#define CAP_I2C_SDA       (1u << 7)
#define CAP_I2C_SCL       (1u << 8)
#define CAP_RESET         (1u << 9)

/* name, port letter (0 = not wired), pin number, capabilities */
static const struct pin_def PINS[] = {
    { "A0", 0, 0, CAP_ANALOG_IN | CAP_DAC },
    { "A4", 0, 0, CAP_I2C_SDA },
    { "A5", 0, 0, CAP_I2C_SCL },
    { "D0", 'A', 9, CAP_UART_TX },
    { "D1", 'A', 10, CAP_UART_RX },
    { "D13", 0, 0, CAP_GPIO | CAP_TIMER_CAPTURE },
    { "D2", 0, 0, CAP_GPIO | CAP_DRIVE },
    { "D5", 'A', 0, CAP_GPIO | CAP_TIMER_CAPTURE },
    { "RST", 'A', 1, CAP_RESET },
};

#define PINS_COUNT 9

#endif
```

## src/pins_table.c
```c
// pin table lookups (the table is generated: see scripts/gen_pins_h.py)
// Plain C (no Zephyr includes) so cmd.c can be compiled and tested on a PC with the real
// lookups. The Zephyr-specific part (port letter -> GPIO device) is in pins.c.

#include "pins.h"
#include "pins_gen.h"
#include <string.h>


const char pins_map_hash[] = PINMAP_HASH;

const struct pin_def* pins_find(const char* name){

    for (size_t i = 0; i < PINS_COUNT; i++){
        if (strcmp(PINS[i].name, name) == 0){
            return &PINS[i];
        }
    }
    return NULL;
}

bool pins_wired(const struct pin_def* p){
    return p != NULL && p->port != 0;
}

bool pins_can_capture(const struct pin_def* p){
    return p != NULL && (p->caps & CAP_TIMER_CAPTURE) != 0;
}


const struct pin_def* pins_reset_line(void){

    for (size_t i = 0; i < PINS_COUNT; i++){
        if (PINS[i].caps & CAP_RESET){
            return &PINS[i];
        }
    }
    return NULL;
}
```

## src/reply.c
```c
// reply builder: see reply.h. Numbers are formatted by hand from integers (no printf, no floats),
// so the output is the same with any libc

#include "reply.h"

#include <string.h>

// longest number this file formats: sign + 20 digits + '.' + 18 decimals, plus slack
#define NUM_MAX 48

// longest decimals reply_fixed accepts (10^18 still fits in a uint64_t with room to spare)
#define MAX_DECIMALS 18

static const char TRUNCATED[] = " truncated=1";

// ------------------------------- helpers -----------------------------------

// append n bytes, or mark the reply as overflowed if they don't fit
static void append(struct reply_buf *r, const char *s, size_t n){

    if (r->overflow){
        return;
    }
    if (r->len + n > PROTO_LINE_MAX){
        r->overflow = true;
        return;
    }
    memcpy(&r->text[r->len], s, n);
    r->len += n;
    r->text[r->len] = '\0';
}

static void append_str(struct reply_buf *r, const char *s){
    append(r, s, strlen(s));
}

// " key="
static void append_key(struct reply_buf *r, const char *key){
    append(r, " ", 1);
    append_str(r, key);
    append(r, "=", 1);
}

// unsigned decimal digits of v into out, returns the length
static size_t fmt_u64(char *out, uint64_t v){

    char rev[20];
    size_t n = 0;

    // digits come out least significant first
    do {
        rev[n++] = (char)('0' + v % 10);
        v /= 10;
    } while (v != 0);

    for (size_t i = 0; i < n; i++){
        out[i] = rev[n - 1 - i];
    }
    return n;
}

// magnitude of v as unsigned, works for INT64_MIN too
static uint64_t magnitude(int64_t v){
    return v < 0 ? (uint64_t)0 - (uint64_t)v : (uint64_t)v;
}

static size_t fmt_int(char *out, int64_t v){

    size_t n = 0;
    if (v < 0){
        out[n++] = '-';
    }
    return n + fmt_u64(&out[n], magnitude(v));
}

// scaled / 10^decimals as "[-]whole.frac", trailing zeros dropped but at least one decimal kept
static size_t fmt_fixed(char *out, int64_t scaled, int decimals){

    uint64_t pow = 1;
    uint64_t mag = magnitude(scaled);
    size_t n = 0;

    if (decimals < 0){
        decimals = 0;
    }
    if (decimals > MAX_DECIMALS){
        decimals = MAX_DECIMALS;
    }
    for (int i = 0; i < decimals; i++){
        pow *= 10;
    }

    if (scaled < 0){
        out[n++] = '-';
    }
    n += fmt_u64(&out[n], mag / pow);
    out[n++] = '.';

    // fraction, zero padded to 'decimals' digits
    uint64_t frac = mag % pow;
    for (int i = decimals - 1; i >= 0; i--){
        out[n + (size_t)i] = (char)('0' + frac % 10);
        frac /= 10;
    }
    n += (size_t)decimals;

    // drop trailing zeros, but keep one digit after the '.'
    while (out[n - 1] == '0' && out[n - 2] != '.'){
        n--;
    }
    if (out[n - 1] == '.'){
        out[n++] = '0';
    }
    return n;
}

// ------------------------------- builders ----------------------------------

void reply_begin(struct reply_buf *r){

    r->len = 0;
    r->overflow = false;
    r->truncated = false;
    r->text[0] = '\0';
    append(r, "OK", 2);
}

void reply_int(struct reply_buf *r, const char *key, int64_t v){

    char num[NUM_MAX];
    append_key(r, key);
    append(r, num, fmt_int(num, v));
}

void reply_fixed(struct reply_buf *r, const char *key, int64_t scaled, int decimals){

    char num[NUM_MAX];
    append_key(r, key);
    append(r, num, fmt_fixed(num, scaled, decimals));
}

void reply_null(struct reply_buf *r, const char *key){

    append_key(r, key);
    append(r, "null", 4);
}

void reply_str(struct reply_buf *r, const char *key, const uint8_t *bytes, size_t n){

    static const char hex[] = "0123456789ABCDEF";

    append_key(r, key);
    append(r, "\"", 1);
    for (size_t i = 0; i < n; i++){
        uint8_t b = bytes[i];

        // safe bytes go as they are, everything else as %XX
        if (b >= 0x21 && b <= 0x7E && b != '%' && b != '"' && b != ','){
            append(r, (const char *)&b, 1);
        }
        else {
            char esc[3] = {'%', hex[b >> 4], hex[b & 0x0F]};
            append(r, esc, 3);
        }
    }
    append(r, "\"", 1);
}

void reply_list_fixed(struct reply_buf *r, const char *key, const int64_t *scaled, size_t n, int decimals){

    char num[NUM_MAX];
    size_t full = 0;

    append_key(r, key);
    append(r, "[", 1);
    if (r->overflow){
        return;
    }

    // first pass: does the whole list (plus the closing ']') fit?
    for (size_t i = 0; i < n; i++){
        full += fmt_fixed(num, scaled[i], decimals) + (i > 0 ? 1 : 0);
    }
    bool cut = r->len + full + 1 > PROTO_LINE_MAX;

    // room to keep at the end: ']' and, if cutting, " truncated=1" (only once per line)
    size_t reserve = 1 + (cut && !r->truncated ? sizeof(TRUNCATED) - 1 : 0);

    for (size_t i = 0; i < n; i++){
        size_t len = fmt_fixed(num, scaled[i], decimals);
        size_t comma = i > 0 ? 1 : 0;

        if (r->len + comma + len + reserve > PROTO_LINE_MAX){
            break;
        }
        append(r, ",", comma);
        append(r, num, len);
    }
    append(r, "]", 1);

    if (cut && !r->truncated){
        append_str(r, TRUNCATED);
        r->truncated = true;
    }
}

void reply_send(struct reply_buf *r, reply_fn reply){

    if (r->overflow){
        reply("ERR INTERNAL reply too long");
        return;
    }
    reply(r->text);
}

void reply_err(reply_fn reply, const char *code, const char *msg){

    char line[PROTO_LINE_MAX + 1];
    size_t n = 0;
    size_t len;

    // "ERR " + code, cut to the line limit
    memcpy(line, "ERR ", 4);
    n = 4;
    len = strlen(code);
    if (len > PROTO_LINE_MAX - n){
        len = PROTO_LINE_MAX - n;
    }
    memcpy(&line[n], code, len);
    n += len;

    // " " + msg, if there is a message and room for it
    if (msg != NULL && msg[0] != '\0' && n + 1 < PROTO_LINE_MAX){
        line[n++] = ' ';
        len = strlen(msg);
        if (len > PROTO_LINE_MAX - n){
            len = PROTO_LINE_MAX - n;
        }
        memcpy(&line[n], msg, len);
        n += len;
    }
    line[n] = '\0';
    reply(line);
}
```

## src/reply.h
```c
// builds "OK key=value ..." reply lines in the format of docs/protocol.md ("Value encoding")
// Plain C (no Zephyr includes) so it can be compiled and tested on a PC: tests/firmware/test_reply_c.py
#ifndef GRADER_REPLY_H
#define GRADER_REPLY_H

#include <stdbool.h>
#include <stddef.h>
#include <stdint.h>

#include "cmd.h"    // reply_fn
#include "link.h"   // PROTO_LINE_MAX

// a reply being built. Once anything doesn't fit, overflow is set and reply_send sends an ERR instead
struct reply_buf {
    char text[PROTO_LINE_MAX + 1];    // added one for the null terminator
    size_t len;
    bool overflow;
    bool truncated;             // a list was cut short and " truncated=1" was already added
};

// starts the line with "OK"
void reply_begin(struct reply_buf *r);

// " key=-12"
void reply_int(struct reply_buf *r, const char *key, int64_t v);

// " key=999.873" from scaled=999873, decimals=3. Never uses floats. Trailing zeros are dropped
// but at least one decimal is kept ("1000.0"), which is how the host prints the same float
void reply_fixed(struct reply_buf *r, const char *key, int64_t scaled, int decimals);

// " key=null"
void reply_null(struct reply_buf *r, const char *key);

// " key="..."" quoted; bytes outside 0x21-0x7E and % " , become %XX
void reply_str(struct reply_buf *r, const char *key, const uint8_t *bytes, size_t n);

// " key=[a,b,c]" of fixed-point values. If the whole list doesn't fit in the line, it stops
// before the limit and adds " truncated=1" after the list
void reply_list_fixed(struct reply_buf *r, const char *key, const int64_t *scaled, size_t n, int decimals);

// sends the line, or "ERR INTERNAL reply too long" if it overflowed
void reply_send(struct reply_buf *r, reply_fn reply);

// sends "ERR <CODE> <msg>" (just "ERR <CODE>" if msg is empty); msg is cut to fit the line
void reply_err(reply_fn reply, const char *code, const char *msg);

#endif
```
